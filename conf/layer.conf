## conf/layer.conf
```bitbake
# We have a conf and classes directory, add to BBPATH
BBPATH .= ":${LAYERDIR}"

# We have recipes-* directories, add to BBFILES
BBFILES += "${LAYERDIR}/recipes-*/*/*.bb \
            ${LAYERDIR}/recipes-*/*/*.bbappend"

BBFILE_COLLECTIONS += "meta-chruselcrypto"
BBFILE_PATTERN_meta-chruselcrypto = "^${LAYERDIR}/"
BBFILE_PRIORITY_meta-chruselcrypto = "6"

LAYERDEPENDS_meta-chruselcrypto = "core"
LAYERSERIES_COMPAT_meta-chruselcrypto = "zeus dunfell"
```
